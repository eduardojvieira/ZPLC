## firmware/tests/app_native_emulation/module/Kconfig
```kconfig
# EMULATION ONLY (native_sim). See emu_shell.c.

config ZPLC_EMU_SHELL
	bool "Shell command to drive the emulated I/O of the learner-board map (native_sim only)"
	help
	  The `emu` shell command drives the inputs and reads the outputs of the
	  learner-board channel map on gpio_emul and adc_emul. It exists for the
	  emulated bench only: the build stops when it is enabled for any board
	  other than native_sim.
```

## firmware/tests/comm_modbus_fb/testcase.yaml
```yaml
tests:
  zplc.comm_modbus_fb:
    tags:
      - zplc
      - modbus
      - comm
    platform_allow:
      - native_sim/native/64
      - native_sim/native
    integration_platforms:
      - native_sim/native/64
    harness: ztest
    timeout: 60
```

## firmware/tests/failsafe_reboot/testcase.yaml
```yaml
tests:
  zplc.failsafe_reboot:
    tags:
      - zplc
      - failsafe
    platform_allow:
      - qemu_cortex_m3
    integration_platforms:
      - qemu_cortex_m3
    harness: console
    harness_config:
      type: multi_line
      ordered: true
      regex:
        - "FAILSAFE-REBOOT phase 1: a processor fault now"
        - "FAILSAFE-REBOOT phase 2: cause=fault"
        - "FAILSAFE-REBOOT phase 2: the record names a processor fault"
        - "FAILSAFE-REBOOT PASS"
    timeout: 30
```

## firmware/tests/hal_gpio_policy/testcase.yaml
```yaml
tests:
  zplc.hal_gpio_policy.required_missing:
    tags:
      - zplc
      - hal
      - gpio
    platform_allow:
      - native_sim/native/64
      - native_sim/native
      - qemu_cortex_m3
    integration_platforms:
      - native_sim/native/64
    harness: ztest
    timeout: 20
    extra_configs:
      - CONFIG_ZPLC_REQUIRED_GPIO_OUTPUT_MASK=0x1
  zplc.hal_gpio_policy.optional_missing:
    tags:
      - zplc
      - hal
      - gpio
    platform_allow:
      - native_sim/native/64
      - native_sim/native
      - qemu_cortex_m3
    integration_platforms:
      - native_sim/native/64
    harness: ztest
    timeout: 20
  # The next two need the GPIO emulator and the LED alias of native_sim: on a
  # board without them the HAL configures no channel and the scenarios would
  # pass or fail for a reason they do not name.
  zplc.hal_gpio_policy.partial_required:
    tags:
      - zplc
      - hal
      - gpio
    platform_allow:
      - native_sim/native/64
      - native_sim/native
    integration_platforms:
      - native_sim/native/64
    harness: ztest
    timeout: 20
    extra_configs:
      - CONFIG_ZPLC_REQUIRED_GPIO_OUTPUT_MASK=0x3
    extra_args:
      - DTC_OVERLAY_FILE=boards/native_sim_emul.overlay
  zplc.hal_gpio_policy.post_shutdown:
    tags:
      - zplc
      - hal
      - gpio
    platform_allow:
      - native_sim/native/64
      - native_sim/native
    integration_platforms:
      - native_sim/native/64
    harness: ztest
    timeout: 20
    extra_configs:
      - CONFIG_ZPLC_REQUIRED_GPIO_OUTPUT_MASK=0x1
    extra_args:
      - DTC_OVERLAY_FILE=boards/native_sim_emul.overlay
```

## firmware/tests/legacy_program_admission/testcase.yaml
```yaml
tests:
  zplc.legacy_program_admission:
    tags:
      - zplc
      - admission
    platform_allow:
      - native_sim/native/64
    integration_platforms:
      - native_sim/native/64
    harness: ztest
    timeout: 20
```

## firmware/tests/modbus_force/testcase.yaml
```yaml
tests:
  zplc.modbus_force:
    tags:
      - zplc
      - modbus
      - safety
    platform_allow:
      - native_sim/native/64
      - native_sim/native
    integration_platforms:
      - native_sim/native/64
    harness: ztest
    timeout: 20
```

## firmware/tests/modbus_override/testcase.yaml
```yaml
tests:
  zplc.modbus_override:
    tags:
      - zplc
      - modbus
      - safety
    platform_allow:
      - native_sim/native/64
      - native_sim/native
      - qemu_cortex_m3
    integration_platforms:
      - native_sim/native/64
    harness: ztest
    timeout: 20
```

## firmware/tests/mqtt_broker_double/testcase.yaml
```yaml
tests:
  zplc.mqtt_broker_double:
    tags:
      - zplc
      - mqtt
      - comm
    platform_allow:
      - native_sim/native/64
      - native_sim/native
    integration_platforms:
      - native_sim/native/64
    harness: ztest
    timeout: 240
```

## firmware/tests/mqtt_command/testcase.yaml
```yaml
tests:
  zplc.mqtt_command:
    tags:
      - zplc
      - mqtt
      - safety
    platform_allow:
      - native_sim
    integration_platforms:
      - native_sim
    harness: ztest
    timeout: 20
```

## firmware/tests/program_boot_restore/testcase.yaml
```yaml
tests:
  zplc.program_boot_restore:
    tags:
      - zplc
      - persistence
      - scheduler
    platform_allow:
      - native_sim/native/64
    integration_platforms:
      - native_sim/native/64
    harness: ztest
    timeout: 20
```

## firmware/tests/program_store/testcase.yaml
```yaml
tests:
  zplc.program_store:
    tags:
      - zplc
      - persistence
    platform_allow:
      - native_sim/native/64
      - native_sim/native
      - qemu_cortex_m3
    integration_platforms:
      - native_sim/native/64
    harness: ztest
    timeout: 20
```

## firmware/tests/scheduler_watchdog/testcase.yaml
```yaml
tests:
  zplc.scheduler_watchdog:
    tags:
      - zplc
      - scheduler
      - failsafe
    platform_allow:
      - native_sim/native/64
      - native_sim/native
      - qemu_cortex_m3
    integration_platforms:
      - native_sim/native/64
    harness: ztest
    timeout: 90
```

## firmware/tests/tls_credentials/testcase.yaml
```yaml
tests:
  zplc.tls_credentials:
    tags:
      - zplc
      - tls
    platform_allow:
      - native_sim/native/64
    integration_platforms:
      - native_sim/native/64
    harness: ztest
    timeout: 20
```
