## CMakeLists.txt
```
cmake_minimum_required(VERSION 3.20.0)
list(PREPEND ZEPHYR_EXTRA_MODULES "${CMAKE_CURRENT_SOURCE_DIR}/../..")
find_package(Zephyr REQUIRED HINTS $ENV{ZEPHYR_BASE})
project(zplc_failsafe_reboot)

target_sources(app PRIVATE src/main.c)
```

## prj.conf
```kconfig
# No ZTEST: the fatal-error handler under test is the firmware's own, the one a product image links.
CONFIG_ZPLC=y
CONFIG_ZPLC_SCHEDULER=n
CONFIG_ZPLC_FATAL_HANDLER=y
CONFIG_PRINTK=y
CONFIG_CONSOLE=y
CONFIG_SHELL=n
CONFIG_LOG=n
CONFIG_ASSERT=y
```

## boards/qemu_cortex_m3.conf
```kconfig
# The ZPLC regions default to 64 KB, which is all the RAM of this board.
CONFIG_ZPLC_WORK_MEMORY_SIZE=2048
CONFIG_ZPLC_RETAIN_MEMORY_SIZE=1024
CONFIG_ZPLC_CODE_SIZE_MAX=8192
```

## src/main.c
```c
/*
 * A real processor fault, a real reboot, and the record after it (RT-019, RT-021).
 *
 * This image is not a ztest: the fatal-error handler under test is the firmware's own. It runs twice in one
 * QEMU session, telling the two runs apart by the record the first one leaves:
 *
 *   phase 1  nothing is recorded: execute an undefined instruction (a usage fault of the processor). The handler
 *            of the firmware drives the outputs safe, writes the record and reboots.
 *   phase 2  the machine was reset by the part: read the reset cause and the record. It must name a fault reset
 *            and the processor fault of phase 1.
 *
 * What this shows: the handler runs on a real fault, the record survives the reboot of the part, and the next
 * boot reads it. What only a board can show: that its reset-cause register agrees, and the level of its pins
 * while it resets (HIL-010).
 */

#include <zephyr/kernel.h>
#include <zephyr/sys/printk.h>

#include <zplc_failsafe.h>

int main(void) {
  const zplc_reset_report_t *report;

  zplc_failsafe_boot();
  report = zplc_failsafe_report();

  if (report->has_fault == 0U) {
    printk("FAILSAFE-REBOOT phase 1: a processor fault now\n");
    k_msleep(50);                      /* the console drains before the fault */
    __asm__ volatile(".short 0xde00"); /* UDF #0: undefined on every Thumb part */
    printk("FAILSAFE-REBOOT FAIL: the instruction did not fault\n");
    return 1;
  }

  printk("FAILSAFE-REBOOT phase 2: cause=%s\n", zplc_reset_cause_name(report->cause));
  if (report->fault.kind == (uint8_t)ZPLC_FAULT_PROCESSOR) {
    printk("FAILSAFE-REBOOT phase 2: the record names a processor fault (reason %u, pc 0x%08x)\n", (unsigned int)report->fault.reason,
           (unsigned int)report->fault.pc);
  }
  if (report->cause == ZPLC_RESET_FAULT && report->fault.kind == (uint8_t)ZPLC_FAULT_PROCESSOR && zplc_reset_may_run(report->cause) == 0) {
    printk("FAILSAFE-REBOOT PASS\n");
  } else {
    printk("FAILSAFE-REBOOT FAIL\n");
  }
  return 0;
}
```
