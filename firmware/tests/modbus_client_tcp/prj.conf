## CMakeLists.txt
```
cmake_minimum_required(VERSION 3.20.0)
list(PREPEND ZEPHYR_EXTRA_MODULES "${CMAKE_CURRENT_SOURCE_DIR}/../..")
find_package(Zephyr REQUIRED HINTS $ENV{ZEPHYR_BASE})
project(zplc_modbus_client_tcp)

target_sources(app PRIVATE
  src/main.c
  ${CMAKE_CURRENT_SOURCE_DIR}/../../app/src/zplc_modbus_client.c
  ${CMAKE_CURRENT_SOURCE_DIR}/../../app/src/zplc_modbus_tcp.c
)
target_include_directories(app PRIVATE
  ${CMAKE_CURRENT_SOURCE_DIR}/../../app/src
  ${CMAKE_CURRENT_SOURCE_DIR}/../../app/include
  ${CMAKE_CURRENT_SOURCE_DIR}/../../lib/zplc_core/include
)

# The files of the runtime compiled into this application are optimized across files as the product's are
# (CONFIG_ZPLC_LTO), so that the suite exercises the code that ships.
if(COMMAND zplc_target_lto)
  zplc_target_lto(app)
endif()
```

## prj.conf
```kconfig
CONFIG_ZTEST=y
CONFIG_ASSERT=y
CONFIG_LOG=n
CONFIG_PRINTK=n
CONFIG_ZTEST_STACK_SIZE=8192
CONFIG_MAIN_STACK_SIZE=8192
CONFIG_HEAP_MEM_POOL_SIZE=16384

CONFIG_MODBUS=y
CONFIG_MODBUS_ROLE_CLIENT=y

CONFIG_NETWORKING=y
CONFIG_NET_IPV4=y
CONFIG_NET_IPV6=n
CONFIG_NET_TCP=y
CONFIG_NET_UDP=y
CONFIG_NET_SOCKETS=y
CONFIG_NET_DRIVERS=y
CONFIG_NET_LOOPBACK=y
CONFIG_ETH_NATIVE_TAP=n
CONFIG_NET_MAX_CONN=32
CONFIG_NET_MAX_CONTEXTS=32
CONFIG_NET_TCP_TIME_WAIT_DELAY=100
CONFIG_ZVFS_OPEN_MAX=32
```

## src/main.c
```c
/*
 * COM-006, COM-012, COM-018: the Modbus TCP client of the product against a
 * Modbus TCP server written for the test, on the loopback interface of the
 * network stack.
 *
 * The client is zplc_modbus_client.c as it is on a board. The server is a
 * thread of this test that answers what the test says: a good response, one
 * that arrives a byte at a time, an exception, the answer to another
 * transaction, silence, and a connection that is closed. The client has to give
 * the documented result for each, in the time its configuration allows.
 */
#include <errno.h>
#include <string.h>

#include <zephyr/kernel.h>
#include <zephyr/modbus/modbus.h>
#include <zephyr/net/socket.h>
#include <zephyr/ztest.h>

#include <zplc_core.h>
#include <zplc_exchange.h>

#include "zplc_config.h"

#define TIMEOUT_MS 400U
#define SERVER_PORT 15020U

/* ---- what the client links against ---- */
uint32_t zplc_config_get_modbus_tcp_client_timeout_ms(void) { return TIMEOUT_MS; }
uint32_t zplc_config_get_modbus_rtu_baud(void) { return 9600U; }
zplc_modbus_parity_t zplc_config_get_modbus_rtu_parity(void) { return ZPLC_MODBUS_PARITY_EVEN; }
bool zplc_config_get_modbus_rtu_client_enabled(void) { return false; }
uint32_t zplc_config_get_modbus_rtu_client_poll_ms(void) { return 1000U; }
uint8_t zplc_config_get_modbus_rtu_client_slave_id(void) { return 1U; }
bool zplc_config_get_modbus_tcp_client_enabled(void) { return false; }
void zplc_config_get_modbus_tcp_client_host(char *buf, size_t len) { strncpy(buf, "127.0.0.1", len); }
uint16_t zplc_config_get_modbus_tcp_client_port(void) { return SERVER_PORT; }
uint8_t zplc_config_get_modbus_tcp_client_unit_id(void) { return 1U; }
uint32_t zplc_config_get_modbus_tcp_client_poll_ms(void) { return 1000U; }
/* the tags of the program the client polls for, and what it writes into the image */
static zplc_tag_entry_t poll_tags[8];
static uint16_t poll_tag_count;
static uint16_t written_addr[8];
static uint16_t written_size[8];
static uint32_t written_value[8];
static int written;
uint16_t zplc_core_get_tag_count(void) { return poll_tag_count; }
const zplc_tag_entry_t *zplc_core_get_tag(uint16_t index) { return index < poll_tag_count ? &poll_tags[index] : NULL; }
int zplc_exchange_write(uint16_t addr, const uint8_t *bytes, uint16_t size) {
  uint32_t value = 0U;

  for (uint16_t i = 0U; i < size && i < 4U; i++) {
    value |= (uint32_t)bytes[i] << (8U * i);
  }
  if (written < 8) {
    written_addr[written] = addr;
    written_size[written] = size;
    written_value[written] = value;
  }
  written++;
  return 0;
}

/* ---- the server of the test ---- */
enum mode {
  MODE_GOOD,
  MODE_FRAGMENTED,
  MODE_EXCEPTION,
  MODE_WRONG_TRANSACTION,
  MODE_WRONG_UNIT,
  MODE_SILENT,
  MODE_CLOSE_AT_ONCE,
  MODE_SHORT_BYTE_COUNT,
};

static volatile enum mode mode;
static volatile bool stop;
static uint8_t last_request[300];
static volatile int last_request_length;
static volatile uint32_t seen[8]; /* function code << 16 | start address of each request, in order */
static volatile int requests;
static struct k_thread server_thread;
static K_THREAD_STACK_DEFINE(server_stack, 4096);

static void put_be16(uint8_t *b, uint16_t v) {
  b[0] = (uint8_t)(v >> 8);
  b[1] = (uint8_t)v;
}

/* The response PDU for a request, as the good server gives it. */
static size_t answer(const uint8_t *req, uint8_t *pdu) {
  const uint8_t fc = req[7];
  const uint16_t count = (uint16_t)((req[10] << 8) | req[11]);

  switch (fc) {
  case 0x03:
    pdu[0] = 0x03;
    pdu[1] = (uint8_t)(count * 2U);
    for (uint16_t i = 0; i < count; i++) {
      put_be16(&pdu[2 + i * 2], (uint16_t)(0x1234 + i));
    }
    return 2U + (size_t)count * 2U;
  case 0x01:
    pdu[0] = 0x01;
    pdu[1] = (uint8_t)((count + 7U) / 8U);
    memset(&pdu[2], 0xA5, pdu[1]);
    return 2U + pdu[1];
  case 0x05:
  case 0x06:
    memcpy(pdu, &req[7], 5);
    return 5U;
  default:
    pdu[0] = (uint8_t)(fc | 0x80);
    pdu[1] = 0x01;
    return 2U;
  }
}

static void server(void *a, void *b, void *c) {
  struct sockaddr_in addr = {0};
  int listener;
  int one = 1;

  ARG_UNUSED(a);
  ARG_UNUSED(b);
  ARG_UNUSED(c);
  listener = zsock_socket(AF_INET, SOCK_STREAM, IPPROTO_TCP);
  zsock_setsockopt(listener, SOL_SOCKET, SO_REUSEADDR, &one, sizeof(one));
  addr.sin_family = AF_INET;
  addr.sin_port = htons(SERVER_PORT);
  zsock_inet_pton(AF_INET, "127.0.0.1", &addr.sin_addr);
  if (zsock_bind(listener, (struct sockaddr *)&addr, sizeof(addr)) < 0 || zsock_listen(listener, 2) < 0) {
    return;
  }
  while (!stop) {
    struct zsock_pollfd fd = {.fd = listener, .events = ZSOCK_POLLIN};
    int conn;
    int n;
    uint8_t adu[300];
    uint8_t pdu[260];
    size_t pdu_length;

    if (zsock_poll(&fd, 1, 50) <= 0) {
      continue;
    }
    conn = zsock_accept(listener, NULL, NULL);
    if (conn < 0) {
      continue;
    }
    if (mode == MODE_CLOSE_AT_ONCE) {
      requests++;
      zsock_close(conn);
      continue;
    }
    n = (int)zsock_recv(conn, adu, sizeof(adu), 0);
    if (n >= 8) {
      requests++;
      memcpy(last_request, adu, (size_t)n);
      last_request_length = n;
      if (requests <= 8) {
        seen[requests - 1] = ((uint32_t)adu[7] << 16) | ((uint32_t)adu[8] << 8) | adu[9];
      }
      if (mode == MODE_SILENT) {
        /* no answer: wait for the client to give up and close */
        struct zsock_pollfd hold = {.fd = conn, .events = ZSOCK_POLLIN};
        uint8_t drop[8];

        (void)zsock_poll(&hold, 1, (int)(TIMEOUT_MS * 3U));
        (void)zsock_recv(conn, drop, sizeof(drop), ZSOCK_MSG_DONTWAIT);
        zsock_close(conn);
        continue;
      }
      pdu_length = answer(adu, pdu);
      if (mode == MODE_EXCEPTION) {
        pdu[0] = (uint8_t)(adu[7] | 0x80);
        pdu[1] = 0x02;
        pdu_length = 2U;
      } else if (mode == MODE_SHORT_BYTE_COUNT && adu[7] == 0x03) {
        pdu[1] = (uint8_t)(pdu[1] - 2U); /* says one register less than it carries */
      }
      {
        uint8_t out[300];

        memcpy(out, adu, 7);
        put_be16(&out[4], (uint16_t)(pdu_length + 1U));
        if (mode == MODE_WRONG_TRANSACTION) {
          put_be16(&out[0], (uint16_t)(((adu[0] << 8) | adu[1]) + 1U));
        }
        if (mode == MODE_WRONG_UNIT) {
          out[6] = (uint8_t)(adu[6] + 1U);
        }
        memcpy(&out[7], pdu, pdu_length);
        if (mode == MODE_FRAGMENTED) {
          for (size_t i = 0; i < 7U + pdu_length; i++) {
            (void)zsock_send(conn, &out[i], 1, 0);
            k_msleep(3);
          }
        } else {
          (void)zsock_send(conn, out, 7U + pdu_length, 0);
        }
      }
    }
    k_msleep(20);
    zsock_close(conn);
  }
  zsock_close(listener);
}

static void *setup(void) {
  stop = false;
  k_thread_create(&server_thread, server_stack, K_THREAD_STACK_SIZEOF(server_stack), server, NULL, NULL, NULL, K_PRIO_PREEMPT(7), 0,
                  K_NO_WAIT);
  k_msleep(100);
  return NULL;
}

static void teardown(void *fixture) {
  ARG_UNUSED(fixture);
  stop = true;
  k_thread_join(&server_thread, K_SECONDS(2));
}

static void before(void *fixture) {
  ARG_UNUSED(fixture);
  mode = MODE_GOOD;
  requests = 0;
  last_request_length = 0;
  poll_tag_count = 0U;
  written = 0;
}

int zplc_modbus_client_poll_tags(bool use_tcp);
int zplc_modbus_tcp_client_read_holding(const char *host, uint16_t port, uint8_t unit_id, uint16_t start_reg, uint16_t count,
                                        uint16_t *out);
int zplc_modbus_tcp_client_write_register(const char *host, uint16_t port, uint8_t unit_id, uint16_t reg, uint16_t value);
int zplc_modbus_tcp_client_read_coils(const char *host, uint16_t port, uint8_t unit_id, uint16_t start_addr, uint16_t count,
                                      uint8_t *out_bits);
int zplc_modbus_tcp_client_write_coil(const char *host, uint16_t port, uint8_t unit_id, uint16_t addr, bool state);

ZTEST(modbus_client_tcp, test_a_read_of_holding_registers_succeeds) {
  uint16_t regs[2] = {0};

  const int rc = zplc_modbus_tcp_client_read_holding("127.0.0.1", SERVER_PORT, 7, 100, 2, regs);

  zassert_equal(rc, 0, "rc %d", rc);
  zassert_equal(regs[0], 0x1234);
  zassert_equal(regs[1], 0x1235);
  zassert_equal(requests, 1);
  zassert_equal(last_request_length, 12);
  zassert_equal(last_request[6], 7, "unit identifier");
  zassert_equal(last_request[7], 0x03, "function code");
  zassert_equal((last_request[8] << 8) | last_request[9], 100, "start address");
  zassert_equal((last_request[10] << 8) | last_request[11], 2, "count");
  zassert_equal((last_request[2] << 8) | last_request[3], 0, "protocol identifier");
}

ZTEST(modbus_client_tcp, test_single_writes_and_coil_reads_succeed) {
  uint8_t bits[1] = {0};

  zassert_ok(zplc_modbus_tcp_client_write_register("127.0.0.1", SERVER_PORT, 1, 5, 0xBEEF));
  zassert_equal(last_request[7], 0x06);
  zassert_equal((last_request[10] << 8) | last_request[11], 0xBEEF);
  zassert_ok(zplc_modbus_tcp_client_write_coil("127.0.0.1", SERVER_PORT, 1, 9, true));
  zassert_equal(last_request[7], 0x05);
  zassert_equal(last_request[10], 0xFF, "ON is 0xFF00");
  zassert_ok(zplc_modbus_tcp_client_read_coils("127.0.0.1", SERVER_PORT, 1, 0, 3, bits));
  zassert_equal(bits[0], 0xA5);
}

/* A TCP response may arrive in pieces; the client puts it back together (COM-006). */
ZTEST(modbus_client_tcp, test_a_response_that_arrives_a_byte_at_a_time_is_read_whole) {
  uint16_t regs[1] = {0};

  mode = MODE_FRAGMENTED;
  zassert_ok(zplc_modbus_tcp_client_read_holding("127.0.0.1", SERVER_PORT, 1, 0, 1, regs));
  zassert_equal(regs[0], 0x1234);
}

ZTEST(modbus_client_tcp, test_an_exception_response_is_an_error) {
  uint16_t regs[1] = {0};

  mode = MODE_EXCEPTION;
  {
    const int rc = zplc_modbus_tcp_client_read_holding("127.0.0.1", SERVER_PORT, 1, 0, 1, regs);

    zassert_equal(rc, -EBADMSG, "rc %d", rc);
  }
  zassert_equal(zplc_modbus_tcp_client_write_register("127.0.0.1", SERVER_PORT, 1, 0, 1), -EBADMSG);
  zassert_equal(regs[0], 0, "no value from an exception");
}

ZTEST(modbus_client_tcp, test_an_answer_to_another_transaction_or_unit_or_count_is_a_protocol_error) {
  uint16_t regs[2] = {0};

  mode = MODE_WRONG_TRANSACTION;
  zassert_equal(zplc_modbus_tcp_client_read_holding("127.0.0.1", SERVER_PORT, 1, 0, 1, regs), -EPROTO);
  mode = MODE_WRONG_UNIT;
  zassert_equal(zplc_modbus_tcp_client_read_holding("127.0.0.1", SERVER_PORT, 1, 0, 1, regs), -EPROTO);
  mode = MODE_SHORT_BYTE_COUNT;
  zassert_equal(zplc_modbus_tcp_client_read_holding("127.0.0.1", SERVER_PORT, 1, 0, 2, regs), -EPROTO);
  zassert_equal(regs[0], 0, "nothing is delivered from an answer that is not the answer");
}

/* COM-018: a server that does not answer is a timeout, after the configured time and not much after. */
ZTEST(modbus_client_tcp, test_a_silent_server_is_a_timeout_in_the_configured_time) {
  uint16_t regs[1] = {0};
  const int64_t start = k_uptime_get();
  int rc;

  mode = MODE_SILENT;
  rc = zplc_modbus_tcp_client_read_holding("127.0.0.1", SERVER_PORT, 1, 0, 1, regs);
  zassert_equal(rc, -ETIMEDOUT);
  zassert_true(k_uptime_get() - start >= TIMEOUT_MS - 20, "not before the time: %lld ms", k_uptime_get() - start);
  zassert_true(k_uptime_get() - start < TIMEOUT_MS + 150, "not long after it: %lld ms", k_uptime_get() - start);
}

ZTEST(modbus_client_tcp, test_a_connection_closed_before_the_answer_and_a_port_with_no_server) {
  uint16_t regs[1] = {0};

  mode = MODE_CLOSE_AT_ONCE;
  zassert_equal(zplc_modbus_tcp_client_read_holding("127.0.0.1", SERVER_PORT, 1, 0, 1, regs), -ECONNRESET);
  /* nothing listens on this port */
  zassert_equal(zplc_modbus_tcp_client_read_holding("127.0.0.1", SERVER_PORT + 1, 1, 0, 1, regs), -ECONNREFUSED);
}

void zplc_modbus_rtu_client_params(struct modbus_iface_param *param);

/* COM-012: the interface of an RTU client waits for a response for rx_timeout MICROseconds. A value in
 * milliseconds there is a thousandth of the wait that was asked for, and every request to a responsive
 * device timed out before its first byte could arrive. */
ZTEST(modbus_client_tcp, test_the_rtu_client_is_given_its_timeout_in_microseconds) {
  struct modbus_iface_param param;

  zplc_modbus_rtu_client_params(&param);
  zassert_equal(param.mode, MODBUS_MODE_RTU);
  zassert_equal(param.rx_timeout, TIMEOUT_MS * 1000U, "rx_timeout is %u", param.rx_timeout);
  zassert_equal(param.serial.baud, 9600U);
  zassert_equal(param.serial.parity, UART_CFG_PARITY_EVEN);
  zassert_equal(param.serial.stop_bits, UART_CFG_STOP_BITS_1);
}

static void add_poll_tag(uint16_t var_addr, uint8_t type, uint32_t number) {
  poll_tags[poll_tag_count] = (zplc_tag_entry_t){
      .var_addr = var_addr,
      .var_type = type,
      .tag_id = ZPLC_TAG_MODBUS,
      .value = number,
  };
  poll_tag_count++;
}

/* The number of a tag says where the variable lives in the notation of the server; the client asks the remote
 * device at the address of that area, not at the number, and leaves the areas it cannot read to the server
 * (COM-011). */
ZTEST(modbus_client_tcp, test_a_polled_tag_is_read_at_the_wire_address_of_its_area) {
  add_poll_tag(0x2000, ZPLC_TYPE_UINT, 40006U); /* holding register 5 */
  add_poll_tag(0x2002, ZPLC_TYPE_BOOL, 7U);     /* coil 7 */
  add_poll_tag(0x2004, ZPLC_TYPE_UINT, 30003U); /* input register 2: the client has no read for it */
  add_poll_tag(0x2006, ZPLC_TYPE_BOOL, 10001U); /* discrete input 0: nor for this */
  add_poll_tag(0x2008, ZPLC_TYPE_INT, 9U);      /* no prefix: holding register 9 */

  zassert_ok(zplc_modbus_client_poll_tags(true));

  zassert_equal(requests, 3, "requests %d", requests);
  zassert_equal(seen[0], (0x03UL << 16) | 5U, "seen %x", seen[0]);
  zassert_equal(seen[1], (0x01UL << 16) | 7U, "seen %x", seen[1]);
  zassert_equal(seen[2], (0x03UL << 16) | 9U, "seen %x", seen[2]);
  zassert_equal(written, 3);
  zassert_equal(written_addr[0], 0x2000U);
  zassert_equal(written_value[0], 0x1234U);
  zassert_equal(written_addr[1], 0x2002U);
  zassert_equal(written_value[1], 1U, "a coil is one bit");
  zassert_equal(written_addr[2], 0x2008U);
}

/* COM-010: a value that the client polls from a remote device is a write from outside the scan, and the only way it
 * reaches the image of the program is zplc_exchange_write(): this suite links no other function that writes the
 * memory of the core, so a client that wrote it directly would not link. The exchange queues the write whole and the
 * scan applies it at its next input latch through the force-aware interface (the exchange suite of the core and
 * modbus_force prove that half). Here the client must hand over a 32-bit value as ONE write of four bytes, and a
 * 16-bit value as one write of two, so that the scan can never see half of it. */
ZTEST(modbus_client_tcp, test_a_polled_value_is_one_whole_write_through_the_exchange) {
  add_poll_tag(0x2010, ZPLC_TYPE_REAL, 40010U); /* holding registers 9 and 10 */
  add_poll_tag(0x2020, ZPLC_TYPE_UINT, 40021U); /* holding register 20 */

  zassert_ok(zplc_modbus_client_poll_tags(true));

  zassert_equal(written, 2, "one write for each tag, not one for each word: %d", written);
  zassert_equal(written_addr[0], 0x2010U);
  zassert_equal(written_size[0], 4U, "a REAL is written whole");
  zassert_equal(written_value[0], 0x12341235U, "the two registers, high word first: %x", written_value[0]);
  zassert_equal(written_addr[1], 0x2020U);
  zassert_equal(written_size[1], 2U, "an INT is written whole");
  zassert_equal(written_value[1], 0x1234U);
}

ZTEST_SUITE(modbus_client_tcp, NULL, setup, before, NULL, teardown);
```
