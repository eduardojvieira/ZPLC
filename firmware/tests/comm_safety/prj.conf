## CMakeLists.txt
```
cmake_minimum_required(VERSION 3.20.0)
list(PREPEND ZEPHYR_EXTRA_MODULES "${CMAKE_CURRENT_SOURCE_DIR}/../..")
find_package(Zephyr REQUIRED HINTS $ENV{ZEPHYR_BASE})
project(zplc_comm_safety)

# COM-022: the application's own guard, applied to this build too: the raw
# memory command of the Zephyr shell is built only together with the
# diagnostic switch.
include(${CMAKE_CURRENT_SOURCE_DIR}/../../app/cmake/zplc_shell_rules.cmake)
zplc_check_shell_rules("${CONFIG_DEVMEM_SHELL}" "${CONFIG_ZPLC_SHELL_RAW_MEMORY}")

target_sources(app PRIVATE
  src/main.c
  src/runtime_stubs.c
  ${CMAKE_CURRENT_SOURCE_DIR}/../../app/src/shell_cmds.c
  ${CMAKE_CURRENT_SOURCE_DIR}/../../app/src/zplc_config.c
  ${CMAKE_CURRENT_SOURCE_DIR}/../../app/src/zplc_time.c
  ${CMAKE_CURRENT_SOURCE_DIR}/../../app/src/program_store.c
  ${CMAKE_CURRENT_SOURCE_DIR}/../../app/src/program_boot_restore.c
  ${CMAKE_CURRENT_SOURCE_DIR}/../../app/src/program_admission.c
)
target_include_directories(app PRIVATE
  ${CMAKE_CURRENT_SOURCE_DIR}/../../app/src
  ${CMAKE_CURRENT_SOURCE_DIR}/../../app/include
  ${CMAKE_CURRENT_SOURCE_DIR}/../../app/tests/include
  ${CMAKE_CURRENT_SOURCE_DIR}/../../lib/zplc_core/include
)

# The files of the runtime compiled into this application are optimized across files as the product's are
# (CONFIG_ZPLC_LTO), so that the suite exercises the code that ships.
if(COMMAND zplc_target_lto)
  zplc_target_lto(app)
endif()
```

## prj.conf
```kconfig
CONFIG_ZTEST=y
CONFIG_ASSERT=y
CONFIG_ZPLC=y
CONFIG_ZPLC_SCHEDULER=y
CONFIG_ZPLC_MAX_TASKS=2
# The store keeps two programs of the code size in the 16 KB storage partition of native_sim and the suite's
# settings beside them (RT-028): the suite loads no program, so the code size is the smallest that is useful.
CONFIG_ZPLC_CODE_SIZE_MAX=4096
# The HAL references the GPIO devices of the board aliases.
CONFIG_GPIO=y
CONFIG_GPIO_EMUL=y

# The shell under test is the one of the product, on the dummy back end.
CONFIG_SHELL=y
CONFIG_SHELL_BACKEND_SERIAL=n
CONFIG_SHELL_BACKEND_DUMMY=y
CONFIG_SHELL_BACKEND_DUMMY_BUF_SIZE=16384
# The line of a frame of the device link at the default payload (shell_cmds.c checks it at build time).
CONFIG_SHELL_CMD_BUFF_SIZE=1280
CONFIG_SHELL_STACK_SIZE=4096
CONFIG_SHELL_METAKEYS=n
CONFIG_REBOOT=y
# A log back end of the test captures every message (COM-015); the shell does
# not interleave log lines into the output the tests compare.
CONFIG_LOG=y
CONFIG_LOG_MODE_IMMEDIATE=y
CONFIG_SHELL_LOG_BACKEND=n
CONFIG_PRINTK=y
CONFIG_HEAP_MEM_POOL_SIZE=4096
CONFIG_MAIN_STACK_SIZE=4096
CONFIG_ZTEST_STACK_SIZE=4096

# Release firmware has no raw memory command (COM-022). The diagnostic
# scenario of testcase.yaml turns this and the switch on together.
CONFIG_DEVMEM_SHELL=n

# The settings are stored through the HAL key-value store (NVS), the same
# store the program store uses; the storage partition of native_sim is the
# simulated flash.
CONFIG_FLASH=y
CONFIG_FLASH_MAP=y
CONFIG_FLASH_PAGE_LAYOUT=y
CONFIG_NVS=y

# The Zephyr settings handler stays the runtime interface to the same rows.
CONFIG_SETTINGS=y
CONFIG_SETTINGS_RUNTIME=y
CONFIG_SETTINGS_NONE=y
CONFIG_FILE_SYSTEM=n
```

## src/runtime_stubs.c
```c
/*
 * The program buffers shell_cmds.c reaches into. In the product they belong to
 * main.c, which starts the whole runtime; the shell under test needs only the
 * storage.
 */
#include <stddef.h>
#include <stdint.h>

#include <errno.h>

#include "program_store.h"

static uint8_t s_program_buf[ZPLC_PROGRAM_STORE_MAX_ARTIFACT_SIZE];
static uint8_t s_program_staging_buf[ZPLC_PROGRAM_STORE_MAX_ARTIFACT_SIZE + ZPLC_PROGRAM_STORE_FOOTER_SIZE];

uint8_t *program_buffer = s_program_buf;
size_t program_buffer_size = ZPLC_PROGRAM_STORE_MAX_ARTIFACT_SIZE;
volatile size_t program_expected_size;
volatile size_t program_received_size;
uint8_t *program_staging_buffer = s_program_staging_buf;
volatile size_t program_staging_received_size;

/* The Wi-Fi link is kept up by main.c; this suite has no radio and links the shell alone. */
int zplc_wifi_request_connect(void) { return -ENOTSUP; }
const char *zplc_wifi_status_name(void) { return "unsupported"; }
```
