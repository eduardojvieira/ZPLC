## firmware/zephyr/Kconfig
```kconfig
# =============================================================================
# ZPLC Kconfig
# =============================================================================
# SPDX-License-Identifier: MIT
#
# Zephyr Kconfig options for the ZPLC runtime module.
# =============================================================================

menuconfig ZPLC
    bool "ZPLC PLC Runtime"
    help
      Enable the ZPLC IEC 61131-3 PLC runtime.
      This provides a portable virtual machine for executing
      PLC programs compiled to the .zplc bytecode format.

if ZPLC

config ZPLC_STACK_DEPTH
    int "Evaluation stack depth"
    default 256
    range 8 4096
    help
      Maximum depth of the VM evaluation stack.
      Each entry is 4 bytes (32-bit), and every registered task has its own
      stack. The stack pointer is 16 bits wide; the upper end of the range is
      a RAM limit long before it is a type limit.

config ZPLC_CALL_STACK_DEPTH
    int "Call stack depth"
    default 32
    range 1 255
    help
      Maximum call nesting depth for subroutines. The call depth is an
      8-bit counter, so 255 is the largest value the VM can hold.

config ZPLC_WORK_MEMORY_SIZE
    int "Work memory size (bytes)"
    default 8192
    range 16 8192
    help
      Size of the work memory region for temporary variables. The region
      owns the 8 KB window 0x2000..0x3FFF of the PLC address space; a larger
      value would only waste RAM and is refused.

config ZPLC_RETAIN_MEMORY_SIZE
    int "Retentive memory size (bytes)"
    default 4096
    range 16 4096
    help
      Size of the retentive memory region. The region owns the 4 KB window
      0x4000..0x4FFF of the PLC address space.
      This memory is persisted across power cycles only when
      ZPLC_RETAIN_PERSIST is enabled.

config ZPLC_CODE_SIZE_MAX
    int "Maximum code size (bytes)"
    default 45056
    range 128 45056
    help
      Largest artifact the runtime accepts, in bytes. This one value is the
      code region of the VM, the largest artifact the program store keeps and
      restores (RT-028), the size of the staging buffers and the size the
      shell and the IDE handshake advertise. Program addresses are 16 bits
      wide and the code region starts at 0x5000, so 45056 (0xB000) is the
      largest value.

      Two program slots of this size have to fit the storage partition of
      the board together with the RETAIN records; the build fails when they
      do not.

config ZPLC_REQUIRED_GPIO_OUTPUT_MASK
    hex "Required logical digital-output mask"
    range 0x0 0xF
    default 0x0
    help
      Bit mask of digital outputs, counted from the first output of the I/O
      table, that must be configured from DeviceTree for the Zephyr HAL to
      initialize, in addition to the channels the board description marks as
      required. The I/O description of a listed board already requires every
      channel it lists; this mask is for a profile without a description (the
      default alias profile). A missing or unconfigurable required channel
      fails HAL initialization; this setting does not qualify the electrical
      behavior of any mapped pin.

config ZPLC_IO_INPUT_IMAGE_BYTES
    int "Input image bytes the I/O table owns (0 = what the board needs)"
    range 0 4080
    default 0
    help
      Bytes of the input process image that the channels of the board use.
      0 takes the size from the board I/O description in
      firmware/app/boards/boards.json (the highest input channel plus its
      width); a larger value reserves room for channels added later. The build
      fails when the value is smaller than the channels need or reaches the
      system registers at the end of the 4 KB input image. The memory the image
      occupies is still the 4 KB of the instruction set: shrinking it is a
      change of the binary contract.

config ZPLC_IO_OUTPUT_IMAGE_BYTES
    int "Output image bytes the I/O table owns (0 = what the board needs)"
    range 0 4096
    default 0
    help
      Bytes of the output process image that the channels of the board use,
      derived from the board I/O description when 0. The build fails when the
      value is smaller than the channels need.

config ZPLC_PROGRAM_STORE_CHUNK_SIZE
    int "Largest piece of a stored program kept under one key (bytes)"
    default 1024
    range 256 2048
    help
      The program store cuts the artifact into chunks of this size and keeps each under its own key, because a
      flash key-value store holds one entry inside one erase sector and an artifact as large as
      ZPLC_CODE_SIZE_MAX (45056 bytes by default) does not fit a 4 KB sector. An artifact of at most one chunk is
      one key, which is the layout of the first version of the store.

      A chunk and the entry overhead of the backend must fit a sector with room for its allocation records:
      1024 fits the 4 KB sector of every board of this repository. The build checks that the storage partition
      holds two slots of ZPLC_CODE_SIZE_MAX in chunks of this size.

config ZPLC_EXCHANGE_QUEUE_BYTES
    int "Bytes of the queue of writes from outside the scan"
    default 1024
    range 256 16384
    help
      A write from a thread outside the scan (Modbus, MQTT, the shell) is queued whole and applied at the input
      latch of the next scan (RT-010). Each queued write takes its data and four bytes of header. A write that does
      not fit is refused, with nothing queued, and the caller sees an error: a Modbus TCP client gets exception 6
      (server device busy). The default holds a Modbus write of 100 mapped registers.

      The exchange also keeps one copy of IPI, OPI, WORK and RETAIN, the snapshot a reader sees, so it costs the
      sum of the four region sizes of RAM besides this queue.

config ZPLC_DEVICE_LINK
    bool "Framed device link protocol (sessions, atomic writes, events)"
    default y
    depends on SHELL
    help
      Builds the engine of the framed device link protocol (COM-019): every state-changing request needs a
      session, a multi-byte write is whole with respect to the scan, and the device pushes events. The text
      shell stays: it is the older protocol and the recovery console.

      A board that has no RAM for it turns it off: Studio then talks to the text shell and says so.

config ZPLC_PROTO_PAYLOAD_MAX
    int "Largest payload of one frame of the device link, in bytes"
    default 512
    range 64 1024
    depends on ZPLC_DEVICE_LINK
    help
      Each link of the protocol keeps one buffer of this size plus 47 bytes, and the engine one more for the
      response it builds. A payload of 264 bytes or more carries the largest force (a 255-character STRING);
      a smaller one makes Studio send a program in smaller chunks and refuse a force it cannot carry.

config ZPLC_PROTO_EVENT_QUEUE
    int "Events the device link can hold until they are sent"
    default 16
    range 4 64
    depends on ZPLC_DEVICE_LINK
    help
      Each queued event takes 66 bytes. A queue that is full drops the newest event and counts it; the link is
      told how many were lost once there is room again. The queue is filled from a low priority context and never
      from the scan.

config ZPLC_PROTO_SESSION_IDLE_S
    int "Seconds of silence after which a session of the device link ends"
    default 30
    range 5 3600
    depends on ZPLC_DEVICE_LINK
    help
      The forces a session set are released when it ends, whatever the reason (COM-020).

config ZPLC_VM_CYCLE_INSTRUCTION_BUDGET
    int "PLC scan instruction budget"
    default 100000
    range 1 10000000
    help
      Maximum VM instructions permitted in one production PLC scan. Reaching
      the limit is a controlled logical VM watchdog fault. It is not a physical
      watchdog, timing measurement, or WCET guarantee.

config ZPLC_LOG_LEVEL
    int "Log level"
    default 3
    range 0 4
    help
      Log level for ZPLC runtime.
      0=OFF, 1=ERR, 2=WRN, 3=INF, 4=DBG

config ZPLC_COMM_THREAD_PRIORITY
    int "Priority of the communication threads"
    default 8
    range 1 14
    help
      Preemptible priority of every thread the application creates to talk
      to the outside: the MQTT client, the Modbus TCP server, the Modbus
      clients and the function-block workers. The scan coordinator (the
      high-priority work queue, or the normal one when there is none) must
      have a lower number, so that a communication thread never delays a
      scan (RT-013); the build fails otherwise. Zephyr's shell and log
      threads run at the lowest application priority unless the build
      overrides them, and the same rule is checked against the override.

# -----------------------------------------------------------------------------
# Multitask Scheduler Configuration
# -----------------------------------------------------------------------------

config ZPLC_SCHEDULER
    bool "Enable multitask scheduler"
    default n
    help
      Enable the ZPLC multitask scheduler.
      Allows running multiple PLC tasks with different intervals
      and priorities using Zephyr's k_timer and work queue system.

if ZPLC_SCHEDULER

config ZPLC_HARDWARE_WATCHDOG
    bool "Enable the profile-owned hardware watchdog"
    default n
    depends on WATCHDOG
    help
      Arms the Zephyr watchdog only while a ZPLC scheduler batch completes
      input snapshot, all due tasks, deadline checks, and one normal output
      commit. It is never fed by an ISR, timer, shell, network, or idle path.

      This default is intentionally off. Enable it only in an exact
      board/revision profile after HIL has verified watchdog reset timing and
      safe outputs. The VM instruction budget remains a logical fault limit;
      it is not this physical watchdog.

config ZPLC_HARDWARE_WATCHDOG_TIMEOUT_MS
    int "Hardware watchdog timeout (ms)"
    range 100 60000
    default 1000
    depends on ZPLC_HARDWARE_WATCHDOG
    help
      Exact profile-owned timeout passed to the Zephyr watchdog driver. This
      setting has no evidence value until HIL verifies the selected device.

config ZPLC_MAX_TASKS
    int "Maximum number of concurrent tasks"
    default 8
    range 2 16
    help
      Maximum number of PLC tasks that can be registered.
      Each task requires approximately 1KB of RAM for its VM state.

config ZPLC_SCHED_WORKQ_STACK_SIZE
    int "Scheduler work queue stack size"
    default 2048
    range 1024 16384
    help
      Stack size for the scheduler work queue thread.
      Increase if tasks require deeper call stacks.

config ZPLC_SCHED_WORKQ_PRIORITY
    int "Scheduler work queue priority"
    default 5
    range 0 14
    help
      Priority of the scheduler work queue thread.
      Lower values = higher priority.
      0 = highest (preempts almost everything)
      14 = lowest cooperative priority

config ZPLC_SCHED_HIGH_PRIO_WORKQ
    bool "Use separate high-priority work queue"
    default y
    help
      Run the single scheduler batch coordinator on a dedicated high-priority
      work queue. Task ordering remains deterministic within each batch.

config ZPLC_SCHED_HIGH_PRIO_STACK_SIZE
    int "High-priority work queue stack size"
    default 2048
    range 1024 16384
    depends on ZPLC_SCHED_HIGH_PRIO_WORKQ
    help
      Stack size for the high-priority work queue thread.

config ZPLC_SCHED_HIGH_PRIO_PRIORITY
    int "High-priority work queue thread priority"
    default 2
    range 0 14
    depends on ZPLC_SCHED_HIGH_PRIO_WORKQ
    help
      Priority of the high-priority work queue thread.
      Must be lower (higher priority) than ZPLC_SCHED_WORKQ_PRIORITY; the
      build fails otherwise.

# -----------------------------------------------------------------------------
# RETAIN persistence (RT-025, RT-026)
# -----------------------------------------------------------------------------

config ZPLC_RETAIN_PERSIST
    bool "Persist the RETAIN region across power cycles"
    depends on ZPLC_SCHED_HIGH_PRIO_WORKQ
    help
      Off by default: the flash write path has been exercised on native_sim and
      QEMU only, and on several boards the storage partition is also used by
      another file system. Turn it on for a board once that board has passed its
      hardware record (HIL-010).

      Restores the RETAIN region when a program is loaded or restored at boot,
      before the first scan, and stores it on STOP and periodically while the
      program runs. A record carries a checksum, a layout hash and the program
      identity, two records alternate, and a record is restored only when both
      the identity and the layout match; otherwise the region is initialised and
      the status says why. The stores go through zplc_hal_persist_*, so this
      needs a working persistence backend (CONFIG_NVS on the boards of this
      repository).

      Periodic saves run on the normal-priority scheduler work queue, never in
      the scan batch and never with the memory lock held. Whether a flash write
      stalls the scan depends on the flash driver and has not been measured on
      any board: see docs/docs/runtime/persistence.md.

if ZPLC_RETAIN_PERSIST

config ZPLC_RETAIN_SAVE_INTERVAL_S
    int "Minimum interval between periodic RETAIN saves (seconds)"
    default 3600
    range 0 86400
    help
      A running program stores its RETAIN region at most once per interval, and
      only when the region changed. 0 turns periodic saves off: only STOP stores.

      The build fails when this interval wears the storage flash out before
      ZPLC_RETAIN_LIFE_YEARS, using ZPLC_RETAIN_FLASH_ENDURANCE_CYCLES and
      ZPLC_RETAIN_FLASH_WEAR_BYTES. The default is deliberately long: a board
      states its own numbers in its board file to earn a shorter interval.

config ZPLC_RETAIN_FLASH_ENDURANCE_CYCLES
    int "Erase cycles per sector the storage flash is rated for"
    default 10000
    range 100 1000000000
    help
      From the datasheet of the part that holds the storage partition. This is
      an engineering input, not a measurement, and the default is the lowest
      class of NOR flash.

config ZPLC_RETAIN_FLASH_WEAR_BYTES
    int "Bytes the storage partition absorbs per erase cycle of all its sectors"
    default 40000
    range 1024 1000000000
    help
      (sectors - 1) * sector size, minus the live data that garbage collection
      copies at every rotation (the two program slots, about 8300 bytes). One
      sector is always kept free for garbage collection.

config ZPLC_RETAIN_ENTRY_OVERHEAD
    int "Backend bytes per stored chunk beyond the data"
    default 64
    range 0 4096
    help
      Entry header and alignment of one chunk: 8 bytes for the NVS allocation
      entry, a data CRC if enabled, and the padding to the flash write block.
      The default covers a 32-byte write block.

config ZPLC_RETAIN_LIFE_YEARS
    int "Flash life the save interval must reach (years)"
    default 10
    range 1 50

config ZPLC_RETAIN_CHUNK_SIZE
    int "Largest RETAIN chunk stored under one key (bytes)"
    default 1024
    range 128 4096
    help
      The RETAIN record is cut into chunks of this size. A chunk plus the
      backend overhead must fit one erase sector minus four allocation entries
      (the NVS limit): 1024 fits a 4 KB sector. The region needs at most eight
      chunks.

endif # ZPLC_RETAIN_PERSIST

endif # ZPLC_SCHEDULER

# -----------------------------------------------------------------------------
# Communication safety (COM-014, COM-022)
# -----------------------------------------------------------------------------

config ZPLC_MQTT_ALLOW_INSECURE_TLS
    bool "Allow MQTT over TLS without verifying the broker certificate"
    default n
    help
      Off by default (COM-014). With it off, `zplc config set mqtt_security 1`
      is refused and a stored value of 1 stops the client from connecting, so
      a release image can never run a TLS session that does not authenticate
      the broker.

      With it on, setting `mqtt_security 1` is the explicit opt-in, and
      `zplc mqtt status` and `zplc status` show tls-verify OFF for as long as
      the session is configured that way. Use it for a bench against a broker
      with a self-signed certificate that you cannot install a CA for.

config ZPLC_SHELL_RAW_MEMORY
    bool "Raw memory shell commands (diagnostic firmware only)"
    default n
    depends on SHELL
    help
      Off by default (COM-022). Raw memory access reads and writes any
      address of the device, not only the PLC regions, so a release image
      has none: `devmem` of the Zephyr shell is not built.

      The diagnostic image sets this and CONFIG_DEVMEM_SHELL=y together
      (firmware/app/diagnostic.conf). The application build stops with an
      error when CONFIG_DEVMEM_SHELL is on and this is off, so the one
      cannot be switched on by accident behind the other.

# -----------------------------------------------------------------------------
# HIL Debug Configuration
# -----------------------------------------------------------------------------

config ZPLC_HIL_DEBUG
    bool "Enable HIL Debugging"
    default n
    help
      Enables Hardware-in-the-Loop debugging features.
      Adds JSON trace output for VM introspection and testing.
      When enabled, the runtime emits structured JSON debug frames
      over serial for automated testing and validation.

endif # ZPLC
```
