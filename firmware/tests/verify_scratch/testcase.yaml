## west.yml
```yaml
manifest:
  version: "1.2"
  projects:
    - name: zephyr
      url: https://github.com/zephyrproject-rtos/zephyr
      revision: dccb09599635bdff17633fa7e9dab014b91dce90
      import: true
  self:
    path: zplc
```
