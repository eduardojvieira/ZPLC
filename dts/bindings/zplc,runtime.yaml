## dts/bindings/zplc,runtime.yaml
```yaml
# =============================================================================
# ZPLC Runtime DeviceTree Binding
# =============================================================================
# SPDX-License-Identifier: MIT
#
# This binding defines the ZPLC runtime node for Zephyr DeviceTree.
# The runtime uses this to discover I/O channel assignments.
#
# Example usage in board overlay:
#
#   / {
#       zplc: zplc {
#           compatible = "zplc,runtime";
#           status = "okay";
#           io-channels = <&gpio0 10 &gpio0 11 &gpio0 12>;
#       };
#   };
#
# =============================================================================

description: |
  ZPLC IEC 61131-3 PLC Runtime node.
  
  This node defines the ZPLC runtime configuration and I/O channel
  assignments for the target board. The runtime reads this configuration
  at startup to map logical I/O channels to physical GPIO pins.

compatible: "zplc,runtime"

properties:
  io-channels:
    type: phandles
    description: |
      List of phandles to GPIO pins used for digital I/O.
      The order defines the logical channel mapping:
      - Channels 0-7: Digital Inputs (DI)
      - Channels 8-15: Digital Outputs (DO)
      
      Each phandle should reference a GPIO pin defined in the board's
      DeviceTree (e.g., &gpio0 10).

  adc-channels:
    type: phandles
    description: |
      List of phandles to ADC channels for analog inputs.
      Optional - only needed if analog I/O is used.

  dac-channels:
    type: phandles
    description: |
      List of phandles to DAC channels for analog outputs.
      Optional - only needed if analog I/O is used.

  cycle-time-us:
    type: int
    default: 10000
    description: |
      Default scan cycle time in microseconds.
      Can be overridden by the loaded .zplc program's task configuration.
      Default is 10000 (10ms).

  watchdog-timeout-ms:
    type: int
    default: 1000
    description: |
      Watchdog timeout in milliseconds.
      If a scan cycle exceeds this duration, the runtime triggers
      a watchdog fault. Default is 1000ms (1 second).

  retain-partition:
    type: string
    description: |
      Name of the flash partition used for retentive memory storage.
      If not specified, retentive memory is not persisted.
      Example: "retain_partition"
```

## firmware/app/build_disco/Kconfig/arch/Kconfig
```kconfig
# Load Zephyr Arch Kconfig descriptions.
osource "/Users/eduardo/zephyrproject/zephyr/arch/rx/Kconfig"
osource "/Users/eduardo/zephyrproject/zephyr/arch/x86/Kconfig"
osource "/Users/eduardo/zephyrproject/zephyr/arch/xtensa/Kconfig"
osource "/Users/eduardo/zephyrproject/zephyr/arch/sparc/Kconfig"
osource "/Users/eduardo/zephyrproject/zephyr/arch/riscv/Kconfig"
osource "/Users/eduardo/zephyrproject/zephyr/arch/posix/Kconfig"
osource "/Users/eduardo/zephyrproject/zephyr/arch/mips/Kconfig"
osource "/Users/eduardo/zephyrproject/zephyr/arch/arm64/Kconfig"
osource "/Users/eduardo/zephyrproject/zephyr/arch/arm/Kconfig"
osource "/Users/eduardo/zephyrproject/zephyr/arch/arc/Kconfig"
```

## firmware/app/build_disco/Kconfig/boards/Kconfig
```kconfig
# Load Zephyr board Kconfig descriptions.
osource "/Users/eduardo/zephyrproject/zephyr/boards/st/stm32f746g_disco/Kconfig"
```

## firmware/app/build_disco/Kconfig/boards/Kconfig.defconfig
```kconfig
# Load Zephyr board defconfig descriptions.
osource "/Users/eduardo/zephyrproject/zephyr/boards/st/stm32f746g_disco/Kconfig.defconfig"
```

## firmware/app/build_disco/Kconfig/boards/Kconfig.stm32f746g_disco
```kconfig
# Load board Kconfig descriptions.
osource "/Users/eduardo/zephyrproject/zephyr/boards/st/stm32f746g_disco/Kconfig.stm32f746g_disco"
```

## firmware/app/build_disco/Kconfig/boards/Kconfig.sysbuild
```kconfig
# Load Sysbuild board Kconfig descriptions.
osource "/Users/eduardo/zephyrproject/zephyr/boards/st/stm32f746g_disco/Kconfig.sysbuild"
```

## firmware/app/build_esp32s3/Kconfig/boards/Kconfig
```kconfig
# Load Zephyr board Kconfig descriptions.
osource "/Users/eduardo/zephyrproject/zephyr/boards/espressif/esp32s3_devkitc/Kconfig"
```

## firmware/app/build_esp32s3/Kconfig/boards/Kconfig.esp32s3_devkitc
```kconfig
# Load board Kconfig descriptions.
osource "/Users/eduardo/zephyrproject/zephyr/boards/espressif/esp32s3_devkitc/Kconfig.esp32s3_devkitc"
```

## firmware/app/build_giga/Kconfig/boards/Kconfig
```kconfig
# Load Zephyr board Kconfig descriptions.
osource "/Users/eduardo/zephyrproject/zephyr/boards/arduino/giga_r1/Kconfig"
```

## firmware/app/build_giga/Kconfig/boards/Kconfig.arduino_giga_r1
```kconfig
# Load board Kconfig descriptions.
osource "/Users/eduardo/zephyrproject/zephyr/boards/arduino/giga_r1/Kconfig.arduino_giga_r1"
```

## firmware/app/build_giga/Kconfig/boards/Kconfig.defconfig
```kconfig
# Load Zephyr board defconfig descriptions.
osource "/Users/eduardo/zephyrproject/zephyr/boards/arduino/giga_r1/Kconfig.defconfig"
```

## firmware/app/build_giga/Kconfig/boards/Kconfig.sysbuild
```kconfig
# Load Sysbuild board Kconfig descriptions.
osource "/Users/eduardo/zephyrproject/zephyr/boards/arduino/giga_r1/Kconfig.sysbuild"
```

## firmware/app/build_giga/Kconfig/soc/Kconfig
```kconfig
# Load Zephyr SoC Kconfig descriptions.
osource "/Users/eduardo/zephyrproject/zephyr/soc/xlnx/zynqmp/Kconfig"
osource "/Users/eduardo/zephyrproject/zephyr/soc/xlnx/zynq7000/Kconfig"
osource "/Users/eduardo/zephyrproject/zephyr/soc/xlnx/versalnet/Kconfig"
osource "/Users/eduardo/zephyrproject/zephyr/soc/xlnx/versal2/Kconfig"
osource "/Users/eduardo/zephyrproject/zephyr/soc/xen/Kconfig"
osource "/Users/eduardo/zephyrproject/zephyr/soc/wch/ch32v/Kconfig"
osource "/Users/eduardo/zephyrproject/zephyr/soc/ti/simplelink/Kconfig"
osource "/Users/eduardo/zephyrproject/zephyr/soc/ti/mspm0/Kconfig"
osource "/Users/eduardo/zephyrproject/zephyr/soc/ti/lm3s6965/Kconfig"
osource "/Users/eduardo/zephyrproject/zephyr/soc/ti/k3/Kconfig"
osource "/Users/eduardo/zephyrproject/zephyr/soc/telink/tlsr/Kconfig"
osource "/Users/eduardo/zephyrproject/zephyr/soc/starfive/jh71xx/Kconfig"
osource "/Users/eduardo/zephyrproject/zephyr/soc/st/stm32/Kconfig"
osource "/Users/eduardo/zephyrproject/zephyr/soc/snps/qemu_arc/Kconfig"
osource "/Users/eduardo/zephyrproject/zephyr/soc/snps/nsim/arc_v/Kconfig"
osource "/Users/eduardo/zephyrproject/zephyr/soc/snps/nsim/arc_classic/Kconfig"
osource "/Users/eduardo/zephyrproject/zephyr/soc/snps/hsdk4xd/Kconfig"
osource "/Users/eduardo/zephyrproject/zephyr/soc/snps/hsdk/Kconfig"
osource "/Users/eduardo/zephyrproject/zephyr/soc/snps/emsk/Kconfig"
osource "/Users/eduardo/zephyrproject/zephyr/soc/snps/emsdp/Kconfig"
osource "/Users/eduardo/zephyrproject/zephyr/soc/snps/arc_iot/Kconfig"
osource "/Users/eduardo/zephyrproject/zephyr/soc/silabs/Kconfig"
osource "/Users/eduardo/zephyrproject/zephyr/soc/sifli/sf32/Kconfig"
osource "/Users/eduardo/zephyrproject/zephyr/soc/sifive/sifive_freedom/Kconfig"
osource "/Users/eduardo/zephyrproject/zephyr/soc/sensry/Kconfig"
osource "/Users/eduardo/zephyrproject/zephyr/soc/rockchip/Kconfig"
osource "/Users/eduardo/zephyrproject/zephyr/soc/renode/riscv_virtual/Kconfig"
osource "/Users/eduardo/zephyrproject/zephyr/soc/renode/cortex_r8_virtual/Kconfig"
osource "/Users/eduardo/zephyrproject/zephyr/soc/renesas/smartbond/Kconfig"
osource "/Users/eduardo/zephyrproject/zephyr/soc/renesas/rz/Kconfig"
osource "/Users/eduardo/zephyrproject/zephyr/soc/renesas/rx/Kconfig"
osource "/Users/eduardo/zephyrproject/zephyr/soc/renesas/rcar/Kconfig"
osource "/Users/eduardo/zephyrproject/zephyr/soc/renesas/ra/Kconfig"
osource "/Users/eduardo/zephyrproject/zephyr/soc/realtek/ec/Kconfig"
osource "/Users/eduardo/zephyrproject/zephyr/soc/raspberrypi/rpi_pico/Kconfig"
osource "/Users/eduardo/zephyrproject/zephyr/soc/quicklogic/eos_s3/Kconfig"
osource "/Users/eduardo/zephyrproject/zephyr/soc/qemu/virt_riscv/Kconfig"
osource "/Users/eduardo/zephyrproject/zephyr/soc/qemu/malta/Kconfig"
osource "/Users/eduardo/zephyrproject/zephyr/soc/openisa/rv32m1/Kconfig"
osource "/Users/eduardo/zephyrproject/zephyr/soc/openhwgroup/cva6/Kconfig"
osource "/Users/eduardo/zephyrproject/zephyr/soc/oct/osd32mp15x/Kconfig"
osource "/Users/eduardo/zephyrproject/zephyr/soc/nxp/s32/Kconfig"
osource "/Users/eduardo/zephyrproject/zephyr/soc/nxp/rw/Kconfig"
osource "/Users/eduardo/zephyrproject/zephyr/soc/nxp/mcx/Kconfig"
osource "/Users/eduardo/zephyrproject/zephyr/soc/nxp/lpc/Kconfig"
osource "/Users/eduardo/zephyrproject/zephyr/soc/nxp/layerscape/Kconfig"
osource "/Users/eduardo/zephyrproject/zephyr/soc/nxp/kinetis/Kconfig"
osource "/Users/eduardo/zephyrproject/zephyr/soc/nxp/imxrt/Kconfig"
osource "/Users/eduardo/zephyrproject/zephyr/soc/nxp/imx/Kconfig"
osource "/Users/eduardo/zephyrproject/zephyr/soc/nuvoton/numicro/Kconfig"
osource "/Users/eduardo/zephyrproject/zephyr/soc/nuvoton/numaker/Kconfig"
osource "/Users/eduardo/zephyrproject/zephyr/soc/nuvoton/npcx/Kconfig"
osource "/Users/eduardo/zephyrproject/zephyr/soc/nuvoton/npcm/Kconfig"
osource "/Users/eduardo/zephyrproject/zephyr/soc/nordic/Kconfig"
osource "/Users/eduardo/zephyrproject/zephyr/soc/neorv32/Kconfig"
osource "/Users/eduardo/zephyrproject/zephyr/soc/native/inf_clock/Kconfig"
osource "/Users/eduardo/zephyrproject/zephyr/soc/microchip/sam/Kconfig"
osource "/Users/eduardo/zephyrproject/zephyr/soc/microchip/sam/sama7/Kconfig"
osource "/Users/eduardo/zephyrproject/zephyr/soc/microchip/sam/sam_d5x_e5x/Kconfig"
osource "/Users/eduardo/zephyrproject/zephyr/soc/microchip/pic32c/pic32cz_ca/Kconfig"
osource "/Users/eduardo/zephyrproject/zephyr/soc/microchip/pic32c/pic32cx_sg/Kconfig"
osource "/Users/eduardo/zephyrproject/zephyr/soc/microchip/pic32c/pic32cm_jh/Kconfig"
osource "/Users/eduardo/zephyrproject/zephyr/soc/microchip/miv/Kconfig"
osource "/Users/eduardo/zephyrproject/zephyr/soc/microchip/mec/Kconfig"
osource "/Users/eduardo/zephyrproject/zephyr/soc/mediatek/mt8xxx/Kconfig"
osource "/Users/eduardo/zephyrproject/zephyr/soc/lowrisc/opentitan/Kconfig"
osource "/Users/eduardo/zephyrproject/zephyr/soc/litex/litex_vexriscv/Kconfig"
osource "/Users/eduardo/zephyrproject/zephyr/soc/ite/ec/Kconfig"
osource "/Users/eduardo/zephyrproject/zephyr/soc/intel/raptor_lake/Kconfig"
osource "/Users/eduardo/zephyrproject/zephyr/soc/intel/panther_lake/Kconfig"
osource "/Users/eduardo/zephyrproject/zephyr/soc/intel/lakemont/Kconfig"
osource "/Users/eduardo/zephyrproject/zephyr/soc/intel/intel_socfpga_std/Kconfig"
osource "/Users/eduardo/zephyrproject/zephyr/soc/intel/intel_socfpga/Kconfig"
osource "/Users/eduardo/zephyrproject/zephyr/soc/intel/intel_niosv/Kconfig"
osource "/Users/eduardo/zephyrproject/zephyr/soc/intel/intel_ish/Kconfig"
osource "/Users/eduardo/zephyrproject/zephyr/soc/intel/intel_adsp/Kconfig"
osource "/Users/eduardo/zephyrproject/zephyr/soc/intel/elkhart_lake/Kconfig"
osource "/Users/eduardo/zephyrproject/zephyr/soc/intel/atom/Kconfig"
osource "/Users/eduardo/zephyrproject/zephyr/soc/intel/apollo_lake/Kconfig"
osource "/Users/eduardo/zephyrproject/zephyr/soc/intel/alder_lake/Kconfig"
osource "/Users/eduardo/zephyrproject/zephyr/soc/infineon/edge/Kconfig"
osource "/Users/eduardo/zephyrproject/zephyr/soc/infineon/cat3/Kconfig"
osource "/Users/eduardo/zephyrproject/zephyr/soc/infineon/cat1c/Kconfig"
osource "/Users/eduardo/zephyrproject/zephyr/soc/infineon/cat1b/Kconfig"
osource "/Users/eduardo/zephyrproject/zephyr/soc/infineon/cat1a/Kconfig"
osource "/Users/eduardo/zephyrproject/zephyr/soc/gd/gd32/Kconfig"
osource "/Users/eduardo/zephyrproject/zephyr/soc/gaisler/leon3/Kconfig"
osource "/Users/eduardo/zephyrproject/zephyr/soc/gaisler/gr716a/Kconfig"
osource "/Users/eduardo/zephyrproject/zephyr/soc/espressif/Kconfig"
osource "/Users/eduardo/zephyrproject/zephyr/soc/ene/kb1200/Kconfig"
osource "/Users/eduardo/zephyrproject/zephyr/soc/ene/kb106x/Kconfig"
osource "/Users/eduardo/zephyrproject/zephyr/soc/egis/Kconfig"
osource "/Users/eduardo/zephyrproject/zephyr/soc/efinix/sapphire/Kconfig"
osource "/Users/eduardo/zephyrproject/zephyr/soc/cdns/xtensa_sample_controller/Kconfig"
osource "/Users/eduardo/zephyrproject/zephyr/soc/cdns/sample_controller32/Kconfig"
osource "/Users/eduardo/zephyrproject/zephyr/soc/cdns/dc233c/Kconfig"
osource "/Users/eduardo/zephyrproject/zephyr/soc/brcm/bcmvk/Kconfig"
osource "/Users/eduardo/zephyrproject/zephyr/soc/brcm/bcm2712/Kconfig"
osource "/Users/eduardo/zephyrproject/zephyr/soc/brcm/bcm2711/Kconfig"
osource "/Users/eduardo/zephyrproject/zephyr/soc/bflb/Kconfig"
osource "/Users/eduardo/zephyrproject/zephyr/soc/atmel/sam0/Kconfig"
osource "/Users/eduardo/zephyrproject/zephyr/soc/atmel/sam/Kconfig"
osource "/Users/eduardo/zephyrproject/zephyr/soc/aspeed/Kconfig"
osource "/Users/eduardo/zephyrproject/zephyr/soc/arm/Kconfig"
osource "/Users/eduardo/zephyrproject/zephyr/soc/arm/beetle/Kconfig"
osource "/Users/eduardo/zephyrproject/zephyr/soc/antmicro/myra/Kconfig"
osource "/Users/eduardo/zephyrproject/zephyr/soc/andestech/Kconfig"
osource "/Users/eduardo/zephyrproject/zephyr/soc/amd/acp_6_0/Kconfig"
osource "/Users/eduardo/zephyrproject/zephyr/soc/ambiq/Kconfig"
osource "/Users/eduardo/zephyrproject/zephyr/soc/aesc/Kconfig"
osource "/Users/eduardo/zephyrproject/zephyr/soc/adi/max32/Kconfig"
```

## firmware/app/build_verify_esp32s3/Kconfig/boards/Kconfig.defconfig
```kconfig
# Load Zephyr board defconfig descriptions.
osource "/Users/eduardo/zephyrproject/zephyr/boards/espressif/esp32s3_devkitc/Kconfig.defconfig"
```
