## zephyr/Kconfig
```kconfig
# =============================================================================
# ZPLC Kconfig
# =============================================================================
# SPDX-License-Identifier: MIT
#
# Zephyr Kconfig options for the ZPLC runtime module.
# =============================================================================

menuconfig ZPLC
    bool "ZPLC PLC Runtime"
    help
      Enable the ZPLC IEC 61131-3 PLC runtime.
      This provides a portable virtual machine for executing
      PLC programs compiled to the .zplc bytecode format.

if ZPLC

config ZPLC_STACK_DEPTH
    int "Evaluation stack depth"
    default 256
    help
      Maximum depth of the VM evaluation stack.
      Each entry is 4 bytes (32-bit).

config ZPLC_CALL_STACK_DEPTH
    int "Call stack depth"
    default 32
    help
      Maximum call nesting depth for subroutines.

config ZPLC_WORK_MEMORY_SIZE
    int "Work memory size (bytes)"
    default 8192
    help
      Size of the work memory region for temporary variables.

config ZPLC_RETAIN_MEMORY_SIZE
    int "Retentive memory size (bytes)"
    default 4096
    help
      Size of the retentive memory region.
      This memory is persisted across power cycles.

config ZPLC_CODE_SIZE_MAX
    int "Maximum code size (bytes)"
    default 45056
    help
      Maximum size of the bytecode segment.

config ZPLC_LOG_LEVEL
    int "Log level"
    default 3
    range 0 4
    help
      Log level for ZPLC runtime.
      0=OFF, 1=ERR, 2=WRN, 3=INF, 4=DBG

# -----------------------------------------------------------------------------
# Multitask Scheduler Configuration
# -----------------------------------------------------------------------------

config ZPLC_SCHEDULER
    bool "Enable multitask scheduler"
    default n
    help
      Enable the ZPLC multitask scheduler.
      Allows running multiple PLC tasks with different intervals
      and priorities using Zephyr's k_timer and work queue system.

if ZPLC_SCHEDULER

config ZPLC_MAX_TASKS
    int "Maximum number of concurrent tasks"
    default 8
    range 2 16
    help
      Maximum number of PLC tasks that can be registered.
      Each task requires approximately 1KB of RAM for its VM state.

config ZPLC_SCHED_WORKQ_STACK_SIZE
    int "Scheduler work queue stack size"
    default 2048
    help
      Stack size for the scheduler work queue thread.
      Increase if tasks require deeper call stacks.

config ZPLC_SCHED_WORKQ_PRIORITY
    int "Scheduler work queue priority"
    default 5
    range 0 14
    help
      Priority of the scheduler work queue thread.
      Lower values = higher priority.
      0 = highest (preempts almost everything)
      14 = lowest cooperative priority

config ZPLC_SCHED_HIGH_PRIO_WORKQ
    bool "Use separate high-priority work queue"
    default y
    help
      Create a separate high-priority work queue for fast tasks.
      When enabled, tasks with priority 0-1 run on high-priority queue,
      and tasks with priority 2+ run on standard work queue.

config ZPLC_SCHED_HIGH_PRIO_STACK_SIZE
    int "High-priority work queue stack size"
    default 2048
    depends on ZPLC_SCHED_HIGH_PRIO_WORKQ
    help
      Stack size for the high-priority work queue thread.

config ZPLC_SCHED_HIGH_PRIO_PRIORITY
    int "High-priority work queue thread priority"
    default 2
    range 0 14
    depends on ZPLC_SCHED_HIGH_PRIO_WORKQ
    help
      Priority of the high-priority work queue thread.
      Should be lower (higher priority) than ZPLC_SCHED_WORKQ_PRIORITY.

endif # ZPLC_SCHEDULER

endif # ZPLC
```
